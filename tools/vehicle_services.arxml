AUTOSAR XML (schema 4.0)
package /Services
  service interface DoorService  # Zentralverriegelung und Türstatus
    methods:
      operation LockAllDoors
      operation UnlockAllDoors
      operation GetDoorState
    events:
      data DoorStateChanged: type=uint8
      data LockStateChanged: type=uint8
    field CentralLockState: type=uint8
  service interface ChargingService  # Ladesteuerung des Hochvoltsystems
    methods:
      operation StartCharging
      operation StopCharging
      operation SetChargeLimit
    events:
      data ChargingStateChanged: type=uint8
    field ChargeLimitPercent: type=uint8
    field StateOfCharge: type=uint8
  service interface DiagnosticService  # Fehlerspeicherzugriff ohne SOME/IP-Deployment
    methods:
      operation ReadFaultMemory
      operation ClearFaultMemory
    events:
      data FaultDetected: type=uint32
package /Deployment
  someip service interface deployment DoorService: service-interface-id=4660, event-deployments=[{event=DoorStateChanged, event-id=32769}, {event=LockStateChanged, event-id=32770}]
    method-deployments:
      method=LockAllDoors, method-id=1
      method=UnlockAllDoors, method-id=2
      method=GetDoorState, method-id=3
  someip service interface deployment ChargingService: service-interface-id=4661, method-deployments=[{method=StartCharging, method-id=1}, {method=StopCharging, method-id=2}], someip-event-deployment{event=ChargingStateChanged, event-id=32769}
