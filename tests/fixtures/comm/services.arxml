AUTOSAR XML (schema 4.0)
package /Services
  service interface DoorService
    methods:
      operation OpenDoor
      operation GetDoorState
    events:
      data DoorStateChanged: type=uint8
    field DoorLockState: type=boolean
package /Deployment
  someip service interface deployment DoorService: service-interface-id=4660, someip-method-deployment{method=OpenDoor, method-id=1}
